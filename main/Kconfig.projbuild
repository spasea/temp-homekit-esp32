## main/Kconfig.projbuild
```kconfig
menu "Example configuration"
    choice EXAMPLE_SHT3X_DEMO
        prompt "Demo mode"
        default EXAMPLE_SHT3X_DEMO_HL
        help
            Choose how to masure values from the sensor. See the main.c for
            details.

        config EXAMPLE_SHT3X_DEMO_HL
            bool "High level"
            help
                In this example it uses the high level function
                sht3x_measure() to perform one measurement in each cycle.

        config EXAMPLE_SHT3X_DEMO_LL
            bool "Low level"
            help
                In this example it starts the measurement, waits for the
                results and fetches the results using separate functions

    endchoice

    config EXAMPLE_SHT3X_ADDR
        hex "I2C address of SHT3x"
        default 0x44
        help
            I2C address of SHT3x, either 0x44 or 0x45. When ADDR pin is
            grounded, choose 0x44. When ADDR pin is pulled up to VDD, choose
            0x45.

    config EXAMPLE_I2C_MASTER_SCL
        int "SCL GPIO Number"
        default 5 if IDF_TARGET_ESP8266
        default 6 if IDF_TARGET_ESP32C3
        default 33 if IDF_TARGET_ESP32 || IDF_TARGET_ESP32S2 || IDF_TARGET_ESP32S3
        help
            GPIO number for I2C Master clock line.

    config EXAMPLE_I2C_MASTER_SDA
        int "SDA GPIO Number"
        default 4 if IDF_TARGET_ESP8266
        default 5 if IDF_TARGET_ESP32C3
        default 32 if IDF_TARGET_ESP32 || IDF_TARGET_ESP32S2 || IDF_TARGET_ESP32S3
        help
            GPIO number for I2C Master data line.

    config EXAMPLE_USE_HARDCODED_SETUP_CODE
        bool "Use hard-coded setup code"
        default y
        help
            HomeKit does not recommend having the setup code programmed in the accessory as is.
            Instead, it expects setup info (salt-verifier pair) generated for the given setup code.
            Use this option only for testing purposes. For production, the setup info should be
            used.

    config EXAMPLE_SETUP_CODE
        string "HomeKit Setup Code"
        default "111-22-333"
        depends on EXAMPLE_USE_HARDCODED_SETUP_CODE
        help
            Setup code to be used for HomeKot pairing, if hard-coded setup code is enabled.

    config EXAMPLE_SETUP_ID
        string "HomeKit Setup Id"
        default "ES32"
        depends on EXAMPLE_USE_HARDCODED_SETUP_CODE
        help
            Setup id to be used for HomeKot pairing, if hard-coded setup code is enabled.
    
    config EXAMPLE_SERIAL_NUM
        string "HomeKit Device serial number"
        default "001122334466"
        help
            Setup serial number for device
endmenu
```
